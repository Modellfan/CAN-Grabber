VERSION ""

NS_ :

BS_:

BU_: Vector__XXX

BO_ 100 Example: 8 Vector__XXX
 SG_ Speed : 0|16@1+ (0.1,0) [0|250] "km/h" Vector__XXX
CM_ SG_ 100 Speed "Vehicle speed";
