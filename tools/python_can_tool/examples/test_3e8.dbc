VERSION ""

NS_ :

BS_:

BU_: Vector__XXX

BO_ 1000 TestMessage: 1 Vector__XXX
 SG_ Status : 0|8@1+ (1,0) [0|255] "" Vector__XXX
