## sdkconfig.defaults
```kconfig
CONFIG_VFS_MAX_OPEN_FILES=12
CONFIG_FATFS_MAX_OPEN_FILES=12

# Wi-Fi performance tuning (ESP32-S3).
# Uncomment ONE rank block below to apply. Values are from ESP-IDF guide.
# Notes:
# - These options trade RAM for throughput.
# - For multiple TCP streams, reduce TCP_*_DEFAULT proportionally.
# - CONFIG_ESP_WIFI_TX_BUFFER should be dynamic (if supported by your IDF).

# --- Rank: Iperf (max performance) ---
#CONFIG_ESP_WIFI_STATIC_RX_BUFFER_NUM=24
#CONFIG_ESP_WIFI_DYNAMIC_RX_BUFFER_NUM=64
#CONFIG_ESP_WIFI_DYNAMIC_TX_BUFFER_NUM=64
#CONFIG_ESP_WIFI_RX_BA_WIN=32
#CONFIG_LWIP_TCP_SND_BUF_DEFAULT=64
#CONFIG_LWIP_TCP_WND_DEFAULT=64
#CONFIG_ESP_WIFI_IRAM_OPT=15
#CONFIG_ESP_WIFI_RX_IRAM_OPT=16
#CONFIG_LWIP_IRAM_OPTIMIZATION=13
#CONFIG_ESP32S3_INSTRUCTION_CACHE_SIZE=32
#CONFIG_ESP32S3_INSTRUCTION_CACHE_LINE_SIZE=32
#CONFIG_ESP32S3_ICACHE_ASSOCIATED_WAYS=8
#CONFIG_ESP32S3_DATA_CACHE_SIZE=32
#CONFIG_ESP32S3_DATA_CACHE_LINE_SIZE=32
#CONFIG_ESP32S3_DCACHE_ASSOCIATED_WAYS=8

# --- Rank: Default (balanced) ---
#CONFIG_ESP_WIFI_STATIC_RX_BUFFER_NUM=8
#CONFIG_ESP_WIFI_DYNAMIC_RX_BUFFER_NUM=32
#CONFIG_ESP_WIFI_DYNAMIC_TX_BUFFER_NUM=32
#CONFIG_ESP_WIFI_RX_BA_WIN=16
#CONFIG_LWIP_TCP_SND_BUF_DEFAULT=32
#CONFIG_LWIP_TCP_WND_DEFAULT=32
#CONFIG_ESP_WIFI_IRAM_OPT=15
#CONFIG_ESP_WIFI_RX_IRAM_OPT=16
#CONFIG_LWIP_IRAM_OPTIMIZATION=13
#CONFIG_ESP32S3_INSTRUCTION_CACHE_SIZE=32
#CONFIG_ESP32S3_INSTRUCTION_CACHE_LINE_SIZE=32
#CONFIG_ESP32S3_ICACHE_ASSOCIATED_WAYS=8
#CONFIG_ESP32S3_DATA_CACHE_SIZE=32
#CONFIG_ESP32S3_DATA_CACHE_LINE_SIZE=32
#CONFIG_ESP32S3_DCACHE_ASSOCIATED_WAYS=8

# --- Rank: Minimum (max memory savings) ---
#CONFIG_ESP_WIFI_STATIC_RX_BUFFER_NUM=3
#CONFIG_ESP_WIFI_DYNAMIC_RX_BUFFER_NUM=6
#CONFIG_ESP_WIFI_DYNAMIC_TX_BUFFER_NUM=6
#CONFIG_ESP_WIFI_RX_BA_WIN=6
#CONFIG_LWIP_TCP_SND_BUF_DEFAULT=6
#CONFIG_LWIP_TCP_WND_DEFAULT=6
#CONFIG_ESP_WIFI_IRAM_OPT=15
#CONFIG_ESP_WIFI_RX_IRAM_OPT=16
#CONFIG_LWIP_IRAM_OPTIMIZATION=0
#CONFIG_ESP32S3_INSTRUCTION_CACHE_SIZE=16
#CONFIG_ESP32S3_INSTRUCTION_CACHE_LINE_SIZE=32
#CONFIG_ESP32S3_ICACHE_ASSOCIATED_WAYS=4
#CONFIG_ESP32S3_DATA_CACHE_SIZE=16
#CONFIG_ESP32S3_DATA_CACHE_LINE_SIZE=32
#CONFIG_ESP32S3_DCACHE_ASSOCIATED_WAYS=4
```
